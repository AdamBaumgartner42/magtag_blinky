/ {
    aliases {
      led0 = &red_led;
    };
    leds {
      compatible = "gpio-leds";
      red_led: led_2 {
        gpios = <&gpio0 13 GPIO_ACTIVE_HIGH>;
        label = "Red - LED2";
      };
    };
};